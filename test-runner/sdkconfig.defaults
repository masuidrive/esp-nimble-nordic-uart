## test-runner/sdkconfig.defaults
```kconfig
CONFIG_ESP_TASK_WDT=n

#
# Nimble Nordic UART Configuration
#
CONFIG_NORDIC_UART_DEVICE_NAME="Nordic UART"
CONFIG_NORDIC_UART_MAX_LINE_LENGTH=256
CONFIG_NORDIC_UART_RX_BUFFER_SIZE=4096
# end of Nimble Nordic UART Configuration
```
